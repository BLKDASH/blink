## main/Kconfig.projbuild
```kconfig
menu "Home Assistant MQTT Configuration"

    config HA_MQTT_BROKER_URI
        string "MQTT Broker URI"
        default "mqtt://192.168.1.100:1883"
        help
            MQTT Broker 地址，格式: mqtt://host:port
            例如: mqtt://192.168.1.100:1883

    config HA_MQTT_USERNAME
        string "MQTT Username"
        default ""
        help
            MQTT 认证用户名，留空表示不使用认证

    config HA_MQTT_PASSWORD
        string "MQTT Password"
        default ""
        help
            MQTT 认证密码

    config HA_MQTT_DEVICE_ID
        string "Device ID"
        default ""
        help
            设备唯一标识符，留空则使用 MAC 地址后 6 位
            用于 MQTT 主题和 Home Assistant 设备标识

endmenu
```
